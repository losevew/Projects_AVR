//------------------------------------------------------------------------------
// This is Open source software. You can place this code on your site, but don't
// forget a link to my YouTube-channel: https://www.youtube.com/channel/UChButpZaL5kUUl_zTyIDFkQ
// Это программное обеспечение распространяется свободно. Вы можете размещать
// его на вашем сайте, но не забудьте указать ссылку на мой YouTube-канал 
// "Электроника в объектике" https://www.youtube.com/channel/UChButpZaL5kUUl_zTyIDFkQ
// Автор: Надыршин Руслан / Nadyrshin Ruslan
//------------------------------------------------------------------------------

#include <delay.h>
#include "max7219.h"





//==============================================================================
// Процедура инициализирует интерфейс обмена с цепочкой max7219
//==============================================================================
void max7219_init(void)
{
   MAX7219_CS_DDR |= (1 << MAX7219_CS_PIN);
	
   MAX7219_CS_PORT |= (1 << MAX7219_CS_PIN);
   MAX7219_CS_HIGHT();
}
//==============================================================================


//==============================================================================
// Процедура отправляет команду с данным в один или во все max7219 в цепочке
//==============================================================================
void max7219_send(uint8_t MAX_Idx, uint8_t Cmd, uint8_t Data)
{
  uint16_t max7219_SpiBuff[MAX7219_NUM];
  uint16_t Word = Data | ((uint16_t) Cmd << 8);
  uint8_t i;
  
  for (i = 0; i < MAX7219_NUM; i++)
  {
    if (MAX_Idx == 0xFF)  // Нужно записать во все max7219 в цепочке
      max7219_SpiBuff[i] = Word;
    else                  // Нужно записать только в один max7219
    {
      if (i == MAX_Idx)         // Та микросхема max7219, в которую нужно записать команду/данные
        max7219_SpiBuff[i] = Word;
      else                      // max7219, которому нет данных на запись
        max7219_SpiBuff[i] = 0x00 | ((uint16_t) MAX7219_CMD_NO_OP << 8);
    }
  }
  
  // Пишем пачку слов во все подключенные max7219
  max7219_sendarray(max7219_SpiBuff);
}
//==============================================================================


//==============================================================================
// Процедура отправляет массив команд в max7219
//==============================================================================
void max7219_sendarray(uint16_t *pArray)
{
  uint8_t i;
  MAX7219_CS_LOW();
  
  for (i = 0; i < MAX7219_NUM; i++)
    max7219_send16bit(*(pArray++));
  
  MAX7219_CS_HIGHT();
}
//==============================================================================


//==============================================================================
// Процедура отправляет 16-битное слово по SPI
//==============================================================================
void max7219_send16bit(uint16_t Word)
{
  // Выдаём старший байт
  spi(hibyte(Word)); 
  // Выдаём младший байт
  spi(lobyte(Word));
}
//==============================================================================


//==============================================================================
// Процедура устанавливает режим декодирования символов в 1 или во всех max7219
//==============================================================================
void max7219_set_decodemode(uint8_t MAX_Idx, uint8_t DecodeMode)
{
  max7219_send(MAX_Idx, MAX7219_CMD_DECODE_MODE, DecodeMode);
}
//==============================================================================


//==============================================================================
// Процедура устанавливает яркость в 1 или во всех max7219
//==============================================================================
void max7219_set_intensity(uint8_t MAX_Idx, uint8_t Intensity)
{
  if (Intensity > 15)
    Intensity = 15;
  
  max7219_send(MAX_Idx, MAX7219_CMD_INTENSITY, Intensity);
}
//==============================================================================


//==============================================================================
// Процедура устанавливает кол-во знаков/строк в 1 или во всех max7219
//==============================================================================
void max7219_set_scan_limit(uint8_t MAX_Idx, uint8_t Limit)
{
  if (Limit > 7)
    Limit = 7;
  
  max7219_send(MAX_Idx, MAX7219_CMD_SCAN_LIMIT, Limit);
}
//==============================================================================


//==============================================================================
// Процедура включает/выключает max7219. После подачи питания он выключен
//==============================================================================
void max7219_set_run_onoff(uint8_t MAX_Idx, uint8_t On)
{
  if (On)
    On = 1;
  
  max7219_send(MAX_Idx, MAX7219_CMD_SHUTDOWN, On);
}
//==============================================================================


//==============================================================================
// Процедура включает/выключает тестовый режим max7219 (горят все индикаторы)
//==============================================================================
void max7219_set_testmode_onoff(uint8_t MAX_Idx, uint8_t On)
{
  if (On)
    On = 1;
  
  max7219_send(MAX_Idx, MAX7219_CMD_DISP_TEST, On);
}
//==============================================================================
